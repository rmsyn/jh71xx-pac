# StarFive VisionFive 2 v1.2A register map
File version: 0.1
From StarFive VisionFive 2 v1.2A,model device generator
Registers are 32-bit, read-write, reset 0x0 unless marked. A register's access mark holds for its fields unless they carry their own. Offsets are from the block's base; lines under a group give offsets from that group; [hi:lo] are bit positions; {n}, {i} and the like mark numbered series; 'fields as' and 'values as' point back to an identical list; <NAME> marks a mode.

## Memory map
0x00000000 rohm_dh2228fv_0 — From rohm,dh2228fv, peripheral generator
0x00000000 jedec_spi_nor_0 — From jedec,spi-nor, peripheral generator
0x00000000 jedec_spi_nor_1 — From jedec,spi-nor, peripheral generator
0x02000000 clint size 0x10000 — From starfive,jh7110-clint, peripheral generator
0x02010000 starfive_jh7110_ccache_0 size 0x4000 — From starfive,jh7110-ccache, peripheral generator
0x02010000 sifive_ccache0_0 size 0x4000 — From sifive,ccache0, peripheral generator
0x02010000 cache_0 size 0x4000 — From cache, peripheral generator
0x0C000000 plic size 0x4000000 — From starfive,jh7110-plic, peripheral generator
0x10000000 uart0 size 0x10000 — From snps,dw-apb-uart, peripheral generator
0x10010000 uart1 size 0x10000 — From snps,dw-apb-uart, peripheral generator
0x10020000 uart2 size 0x10000 — From snps,dw-apb-uart, peripheral generator
0x10030000 i2c0 size 0x10000 — From snps,designware-i2c, peripheral generator
0x10040000 i2c1 size 0x10000 — From snps,designware-i2c, peripheral generator
0x10050000 i2c2 size 0x10000 — From snps,designware-i2c, peripheral generator
0x10060000 spi0 size 0x10000 — From arm,pl022, peripheral generator
0x10060000 arm_primecell_0 size 0x10000 — From arm,primecell, peripheral generator
0x10070000 spi1 size 0x10000 — From arm,pl022, peripheral generator
0x10070000 arm_primecell_1 size 0x10000 — From arm,primecell, peripheral generator
0x10080000 spi2 size 0x10000 — From arm,pl022, peripheral generator
0x10080000 arm_primecell_2 size 0x10000 — From arm,primecell, peripheral generator
0x10090000 starfive_jh7110_tdm_0 size 0x1000 — From starfive,jh7110-tdm, peripheral generator
0x10200000 starfive_jh7110_usb_phy_0 size 0x10000 — From starfive,jh7110-usb-phy, peripheral generator
0x10210000 starfive_jh7110_pcie_phy_0 size 0x10000 — From starfive,jh7110-pcie-phy, peripheral generator
0x10220000 starfive_jh7110_pcie_phy_1 size 0x10000 — From starfive,jh7110-pcie-phy, peripheral generator
0x10230000 stgcrg size 0x10000 — From starfive,jh7110-stgcrg, peripheral generator
0x10240000 stg_syscon size 0x1000 — From starfive,jh7110-stg-syscon, peripheral generator
0x10240000 syscon_0 size 0x1000 — From syscon, peripheral generator
0x12000000 uart3 size 0x10000 — From snps,dw-apb-uart, peripheral generator
0x12010000 uart4 size 0x10000 — From snps,dw-apb-uart, peripheral generator
0x12020000 uart5 size 0x10000 — From snps,dw-apb-uart, peripheral generator
0x12030000 i2c3 size 0x10000 — From snps,designware-i2c, peripheral generator
0x12040000 i2c4 size 0x10000 — From snps,designware-i2c, peripheral generator
0x12050000 i2c5 size 0x10000 — From snps,designware-i2c, peripheral generator
0x12060000 i2c6 size 0x10000 — From snps,designware-i2c, peripheral generator
0x12070000 spi3 size 0x10000 — From arm,pl022, peripheral generator
0x12070000 arm_primecell_3 size 0x10000 — From arm,primecell, peripheral generator
0x12080000 spi4 size 0x10000 — From arm,pl022, peripheral generator
0x12080000 arm_primecell_4 size 0x10000 — From arm,primecell, peripheral generator
0x12090000 spi5 size 0x10000 — From arm,pl022, peripheral generator
0x12090000 arm_primecell_5 size 0x10000 — From arm,primecell, peripheral generator
0x120A0000 spi6 size 0x10000 — From arm,pl022, peripheral generator
0x120A0000 arm_primecell_6 size 0x10000 — From arm,primecell, peripheral generator
0x120D0000 pwm size 0x10000 — From starfive,jh7110-pwm, peripheral generator
0x120E0000 starfive_jh7110_temp_0 size 0x10000 — From starfive,jh7110-temp, peripheral generator
0x13000000 dmc_phy size 0x10000 — From starfive,jh7110-dmc-phy, peripheral generator
0x13010000 starfive_jh7110_qspi_0 size 0x10000 — From starfive,jh7110-qspi, peripheral generator
0x13010000 qspi size 0x10000 — From cdns,qspi-nor, peripheral generator
0x13020000 syscrg size 0x10000 — From starfive,jh7110-syscrg, peripheral generator
0x13030000 sys_syscon size 0x1000 — From starfive,jh7110-sys-syscon, peripheral generator
0x13030000 syscon_1 size 0x1000 — From syscon, peripheral generator
0x13030000 simple_mfd_0 size 0x1000 — From simple-mfd, peripheral generator
0x13040000 sys_pinctrl size 0x10000 — From starfive,jh7110-sys-pinctrl, peripheral generator
0x13070000 starfive_jh7110_wdt_0 size 0x10000 — From starfive,jh7110-wdt, peripheral generator
0x15700000 dmc_ctrl size 0x10000 — From starfive,jh7110-dmc-ctrl, peripheral generator
0x16000000 starfive_jh7110_crypto_0 size 0x4000 — From starfive,jh7110-crypto, peripheral generator
0x16008000 arm_pl080_0 size 0x4000 — From arm,pl080, peripheral generator
0x16008000 arm_primecell_7 size 0x4000 — From arm,primecell, peripheral generator
0x1600C000 trng size 0x4000 — From starfive,jh7110-trng, peripheral generator
0x16010000 starfive_jh7110_mmc_0 size 0x10000 — From starfive,jh7110-mmc, peripheral generator
0x16020000 starfive_jh7110_mmc_1 size 0x10000 — From starfive,jh7110-mmc, peripheral generator
0x16030000 starfive_jh7110_dwmac_0 size 0x10000 — From starfive,jh7110-dwmac, peripheral generator
0x16030000 snps_dwmac_0 size 0x10000 — From snps,dwmac, peripheral generator
0x16040000 starfive_jh7110_dwmac_1 size 0x10000 — From starfive,jh7110-dwmac, peripheral generator
0x16040000 snps_dwmac_1 size 0x10000 — From snps,dwmac, peripheral generator
0x16050000 starfive_jh7110_axi_dma_0 size 0x10000 — From starfive,jh7110-axi-dma, peripheral generator
0x17000000 aoncrg size 0x10000 — From starfive,jh7110-aoncrg, peripheral generator
0x17010000 aon_syscon size 0x1000 — From starfive,jh7110-aon-syscon, peripheral generator
0x17010000 syscon_2 size 0x1000 — From syscon, peripheral generator
0x17020000 aon_pinctrl size 0x10000 — From starfive,jh7110-aon-pinctrl, peripheral generator
0x17030000 pmu size 0x10000 — From starfive,jh7110-pmu, peripheral generator
0x19810000 starfive_jh7110_ispcrg_0 size 0x10000 — From starfive,jh7110-ispcrg, peripheral generator
0x21000000 starfive_jh7110_xspi_0 size 0x400000 — From starfive,jh7110-xspi, peripheral generator
0x21000000 cdns_xspi_nor_0 size 0x400000 — From cdns,xspi-nor, peripheral generator
0x295C0000 starfive_jh7110_voutcrg_0 size 0x10000 — From starfive,jh7110-voutcrg, peripheral generator

## Interrupts
20 qspi
27 uart0
28 uart1
29 uart2
30 i2c0
31 i2c1
32 i2c2
33 spi0
34 spi1
35 spi2
40 uart3
41 uart4
42 uart5
43 i2c3
44 i2c4
45 i2c5
46 i2c6
47 spi3
48 spi4
49 spi5
50 spi6
106 pmu
